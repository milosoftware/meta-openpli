## meta-openpli/conf/distro/reporefs.conf
```bitbake
SRCREV_pn-firmware-af9005 ??= "4b2b151e1842d172e76c2e0a6bfa1f4284a5e344"
SRCREV_pn-firmware-as102-data1-st ??= "4b2b151e1842d172e76c2e0a6bfa1f4284a5e344"
SRCREV_pn-firmware-as102-data2-st ??= "4b2b151e1842d172e76c2e0a6bfa1f4284a5e344"
SRCREV_pn-firmware-cx231xx ??= "4b2b151e1842d172e76c2e0a6bfa1f4284a5e344"
SRCREV_pn-firmware-drx397xd.a2 ??= "4b2b151e1842d172e76c2e0a6bfa1f4284a5e344"
SRCREV_pn-firmware-drx397xd.b1 ??= "4b2b151e1842d172e76c2e0a6bfa1f4284a5e344"
SRCREV_pn-firmware-drxd-a2-1.1 ??= "4b2b151e1842d172e76c2e0a6bfa1f4284a5e344"
SRCREV_pn-firmware-drxd-b1-1.1 ??= "4b2b151e1842d172e76c2e0a6bfa1f4284a5e344"
SRCREV_pn-firmware-dvb-demod-m88ds3103 ??= "4b2b151e1842d172e76c2e0a6bfa1f4284a5e344"
SRCREV_pn-firmware-dvb-demod-mn88472-02 ??= "4b2b151e1842d172e76c2e0a6bfa1f4284a5e344"
SRCREV_pn-firmware-dvb-demod-mn88473-01 ??= "4b2b151e1842d172e76c2e0a6bfa1f4284a5e344"
SRCREV_pn-firmware-dvb-demod-si2168-a20 ??= "4b2b151e1842d172e76c2e0a6bfa1f4284a5e344"
SRCREV_pn-firmware-dvb-demod-si2168-a30 ??= "4b2b151e1842d172e76c2e0a6bfa1f4284a5e344"
SRCREV_pn-firmware-dvb-demod-si2168-b40 ??= "4b2b151e1842d172e76c2e0a6bfa1f4284a5e344"
SRCREV_pn-firmware-dvb-demod-si2168-d60 ??= "4b2b151e1842d172e76c2e0a6bfa1f4284a5e344"
SRCREV_pn-firmware-dvb-fe-af9013 ??= "4b2b151e1842d172e76c2e0a6bfa1f4284a5e344"
SRCREV_pn-firmware-dvb-fe-cx24117 ??= "4b2b151e1842d172e76c2e0a6bfa1f4284a5e344"
SRCREV_pn-firmware-dvb-fe-ds3000 ??= "4b2b151e1842d172e76c2e0a6bfa1f4284a5e344"
SRCREV_pn-firmware-dvb-fe-tda10071 ??= "4b2b151e1842d172e76c2e0a6bfa1f4284a5e344"
SRCREV_pn-firmware-dvb-fe-xc5000-1.1 ??= "4b2b151e1842d172e76c2e0a6bfa1f4284a5e344"
SRCREV_pn-firmware-dvb-fe-xc5000-1.6.114 ??= "4b2b151e1842d172e76c2e0a6bfa1f4284a5e344"
SRCREV_pn-firmware-dvb-nova-12mhz-b0 ??= "4b2b151e1842d172e76c2e0a6bfa1f4284a5e344"
SRCREV_pn-firmware-dvb-siano ??= "4b2b151e1842d172e76c2e0a6bfa1f4284a5e344"
SRCREV_pn-firmware-dvb-tuner-si2141-a10 ??= "4b2b151e1842d172e76c2e0a6bfa1f4284a5e344"
SRCREV_pn-firmware-dvb-tuner-si2158-a20 ??= "4b2b151e1842d172e76c2e0a6bfa1f4284a5e344"
SRCREV_pn-firmware-dvb-usb-adstech-usb2-02 ??= "4b2b151e1842d172e76c2e0a6bfa1f4284a5e344"
SRCREV_pn-firmware-dvb-usb-af9015 ??= "4b2b151e1842d172e76c2e0a6bfa1f4284a5e344"
SRCREV_pn-firmware-dvb-usb-af9035-01 ??= "4b2b151e1842d172e76c2e0a6bfa1f4284a5e344"
SRCREV_pn-firmware-dvb-usb-af9035-02 ??= "4b2b151e1842d172e76c2e0a6bfa1f4284a5e344"
SRCREV_pn-firmware-dvb-usb-avertv-a800-02 ??= "4b2b151e1842d172e76c2e0a6bfa1f4284a5e344"
SRCREV_pn-firmware-dvb-usb-bluebird-01 ??= "4b2b151e1842d172e76c2e0a6bfa1f4284a5e344"
SRCREV_pn-firmware-dvb-usb-bluebird-02 ??= "4b2b151e1842d172e76c2e0a6bfa1f4284a5e344"
SRCREV_pn-firmware-dvb-usb-dib0700-01 ??= "4b2b151e1842d172e76c2e0a6bfa1f4284a5e344"
SRCREV_pn-firmware-dvb-usb-dib0700-03-pre1 ??= "4b2b151e1842d172e76c2e0a6bfa1f4284a5e344"
SRCREV_pn-firmware-dvb-usb-dib0700-1.10 ??= "4b2b151e1842d172e76c2e0a6bfa1f4284a5e344"
SRCREV_pn-firmware-dvb-usb-dib0700-1.20 ??= "4b2b151e1842d172e76c2e0a6bfa1f4284a5e344"
SRCREV_pn-firmware-dvb-usb-dibusb-5.0.0.11 ??= "4b2b151e1842d172e76c2e0a6bfa1f4284a5e344"
SRCREV_pn-firmware-dvb-usb-dibusb-6.0.0.8 ??= "4b2b151e1842d172e76c2e0a6bfa1f4284a5e344"
SRCREV_pn-firmware-dvb-usb-dibusb-an2235-01 ??= "4b2b151e1842d172e76c2e0a6bfa1f4284a5e344"
SRCREV_pn-firmware-dvb-usb-digitv-02 ??= "4b2b151e1842d172e76c2e0a6bfa1f4284a5e344"
SRCREV_pn-firmware-dvb-usb-digivox-02 ??= "4b2b151e1842d172e76c2e0a6bfa1f4284a5e344"
SRCREV_pn-firmware-dvb-usb-dposh-01 ??= "4b2b151e1842d172e76c2e0a6bfa1f4284a5e344"
SRCREV_pn-firmware-dvb-usb-dtt200u-01 ??= "4b2b151e1842d172e76c2e0a6bfa1f4284a5e344"
SRCREV_pn-firmware-dvb-usb-ec168 ??= "4b2b151e1842d172e76c2e0a6bfa1f4284a5e344"
SRCREV_pn-firmware-dvb-usb-it9135 ??= "4b2b151e1842d172e76c2e0a6bfa1f4284a5e344"
SRCREV_pn-firmware-dvb-usb-it913x ??= "4b2b151e1842d172e76c2e0a6bfa1f4284a5e344"
SRCREV_pn-firmware-dvb-usb-megasky-02 ??= "4b2b151e1842d172e76c2e0a6bfa1f4284a5e344"
SRCREV_pn-firmware-dvb-usb-nova-t-usb2-01 ??= "4b2b151e1842d172e76c2e0a6bfa1f4284a5e344"
SRCREV_pn-firmware-dvb-usb-nova-t-usb2-02 ??= "4b2b151e1842d172e76c2e0a6bfa1f4284a5e344"
SRCREV_pn-firmware-dvb-usb-s660 ??= "4b2b151e1842d172e76c2e0a6bfa1f4284a5e344"
SRCREV_pn-firmware-dvb-usb-tbs5520 ??= "4b2b151e1842d172e76c2e0a6bfa1f4284a5e344"
SRCREV_pn-firmware-dvb-usb-tbs5925 ??= "4b2b151e1842d172e76c2e0a6bfa1f4284a5e344"
SRCREV_pn-firmware-dvb-usb-tbs5980 ??= "4b2b151e1842d172e76c2e0a6bfa1f4284a5e344"
SRCREV_pn-firmware-dvb-usb-technisat-skystar ??= "4b2b151e1842d172e76c2e0a6bfa1f4284a5e344"
SRCREV_pn-firmware-dvb-usb-tvwalkert ??= "4b2b151e1842d172e76c2e0a6bfa1f4284a5e344"
SRCREV_pn-firmware-dvb-usb-umt-010-02 ??= "4b2b151e1842d172e76c2e0a6bfa1f4284a5e344"
SRCREV_pn-firmware-dvb-usb-wt220u-02 ??= "4b2b151e1842d172e76c2e0a6bfa1f4284a5e344"
SRCREV_pn-firmware-dvb-usb-wt220u-fc03 ??= "4b2b151e1842d172e76c2e0a6bfa1f4284a5e344"
SRCREV_pn-firmware-dvb-usb-wt220u-miglia-01 ??= "4b2b151e1842d172e76c2e0a6bfa1f4284a5e344"
SRCREV_pn-firmware-dvb-usb-wt220u-zl0353-01 ??= "4b2b151e1842d172e76c2e0a6bfa1f4284a5e344"
SRCREV_pn-firmware-isdbt-nova-12mhz-b0 ??= "4b2b151e1842d172e76c2e0a6bfa1f4284a5e344"
SRCREV_pn-firmware-marvell-sd8688 ??= "4b2b151e1842d172e76c2e0a6bfa1f4284a5e344"
SRCREV_pn-firmware-sms1xxx-nova-b-dvbt-01 ??= "4b2b151e1842d172e76c2e0a6bfa1f4284a5e344"
SRCREV_pn-firmware-sms1xxx-hcw-114xxx-cmmb-01 ??= "4b2b151e1842d172e76c2e0a6bfa1f4284a5e344"
SRCREV_pn-firmware-sms1xxx-hcw-55xxx-dvbt-01 ??= "4b2b151e1842d172e76c2e0a6bfa1f4284a5e344"
SRCREV_pn-firmware-sms1xxx-hcw-55xxx-dvbt-02 ??= "4b2b151e1842d172e76c2e0a6bfa1f4284a5e344"
SRCREV_pn-firmware-sms1xxx-hcw-55xxx-dvbt-03 ??= "4b2b151e1842d172e76c2e0a6bfa1f4284a5e344"
SRCREV_pn-firmware-sms1xxx-hcw-55xxx-isdbt-02 ??= "4b2b151e1842d172e76c2e0a6bfa1f4284a5e344"
SRCREV_pn-firmware-sms1xxx-hcw-55xxx-isdbt-03 ??= "4b2b151e1842d172e76c2e0a6bfa1f4284a5e344"
SRCREV_pn-firmware-sms1xxx-nova-a-dvbt-01 ??= "4b2b151e1842d172e76c2e0a6bfa1f4284a5e344"
SRCREV_pn-firmware-xc3028-dvico-au-01 ??= "4b2b151e1842d172e76c2e0a6bfa1f4284a5e344"
SRCREV_pn-firmware-xc3028-v27 ??= "4b2b151e1842d172e76c2e0a6bfa1f4284a5e344"
SRCREV_pn-firmware-xc3028l-v36 ??= "4b2b151e1842d172e76c2e0a6bfa1f4284a5e344"
SRCREV_pn-firmware-xc5000 ??= "4b2b151e1842d172e76c2e0a6bfa1f4284a5e344"
SRCREV_pn-firmware-xc5000c ??= "4b2b151e1842d172e76c2e0a6bfa1f4284a5e344"

# usb wlan linux firmwares
SRCREV_pn-firmware-atheros-ar9271 ??= "4b2b151e1842d172e76c2e0a6bfa1f4284a5e344"
SRCREV_pn-firmware-carl9170 ??= "4b2b151e1842d172e76c2e0a6bfa1f4284a5e344"
SRCREV_pn-firmware-htc7010 ??= "4b2b151e1842d172e76c2e0a6bfa1f4284a5e344"
SRCREV_pn-firmware-htc9271 ??= "4b2b151e1842d172e76c2e0a6bfa1f4284a5e344"
SRCREV_pn-firmware-mt7601u ??= "4b2b151e1842d172e76c2e0a6bfa1f4284a5e344"
SRCREV_pn-firmware-mt7650 ??= "4b2b151e1842d172e76c2e0a6bfa1f4284a5e344"
SRCREV_pn-firmware-rt2870 ??= "4b2b151e1842d172e76c2e0a6bfa1f4284a5e344"
SRCREV_pn-firmware-rt73 ??= "4b2b151e1842d172e76c2e0a6bfa1f4284a5e344"
SRCREV_pn-firmware-rtl8188eu ??= "4b2b151e1842d172e76c2e0a6bfa1f4284a5e344"
SRCREV_pn-firmware-rtl8188fu ??= "4b2b151e1842d172e76c2e0a6bfa1f4284a5e344"
SRCREV_pn-firmware-rtl8192cu ??= "4b2b151e1842d172e76c2e0a6bfa1f4284a5e344"
SRCREV_pn-firmware-rtl8192eu ??= "4b2b151e1842d172e76c2e0a6bfa1f4284a5e344"
SRCREV_pn-firmware-rtl8712u ??= "4b2b151e1842d172e76c2e0a6bfa1f4284a5e344"
SRCREV_pn-firmware-rtl8723bs ??= "4b2b151e1842d172e76c2e0a6bfa1f4284a5e344"
SRCREV_pn-firmware-rtl8723bu ??= "4b2b151e1842d172e76c2e0a6bfa1f4284a5e344"
SRCREV_pn-firmware-rtl8822be ??= "4b2b151e1842d172e76c2e0a6bfa1f4284a5e344"
SRCREV_pn-firmware-rtl8xxxu ??= "4b2b151e1842d172e76c2e0a6bfa1f4284a5e344"
SRCREV_pn-firmware-zd1211 ??= "4b2b151e1842d172e76c2e0a6bfa1f4284a5e344"

# e2openplugins
SRCREV_pn-enigma2-plugin-extensions-addstreamurl ??= "c94fb2b9e8e858cff8af4ef230b801868e8c3f11"
SRCREV_pn-enigma2-plugin-extensions-analogclock ??= "96586716ba7d41d22851ea44c2f4b0a218c55d24"
SRCREV_pn-enigma2-plugin-extensions-antilogo ??= "a90e64cde3a1d141e266de63444309d21f5a3d94"
SRCREV_pn-enigma2-plugin-extensions-autobackup ??= "40131c85d6521ecacccd8883669d7401489e0883"
SRCREV_pn-enigma2-plugin-extensions-autobouquets ??= "6fbb0eb4344fee99c66a2b40b157f30ce67d3ce9"
SRCREV_pn-enigma2-plugin-extensions-bhtunerserver ??= "90746709079d14ba850d719a74209ba5e5997229"
SRCREV_pn-enigma2-plugin-extensions-bitrate ??= "d55ee41490c8f638329643c5e5c1c8c49648592a"
SRCREV_pn-enigma2-plugin-extensions-blackoutblind ??= "83baad56494728b795f828f6abeb6ebc26dd1514"
SRCREV_pn-enigma2-plugin-extensions-cacheflush ??= "deb3f9b22ae962d8e22d06e122c5184c845fbd14"
SRCREV_pn-enigma2-plugin-extensions-changerootpassword ??= "589cfda1dd01bae61a193f074c71ff99cc2290a0"
SRCREV_pn-enigma2-plugin-extensions-czechmeteo ??= "d7e02370184aff06f5e382b2a879fe599773313a"
SRCREV_pn-enigma2-plugin-extensions-epgimportfilter ??= "b20621edac5f6dbdc51c42c503e78b18e8286029"
SRCREV_pn-enigma2-plugin-extensions-filecommander ??= "76d5946ce29f2c6ba4bd8a80c5df1f27e3b52b56"
SRCREV_pn-enigma2-plugin-extensions-foreca ??= "b7cedc34ae312f9067475664a3a664f2efcb5aea"
SRCREV_pn-enigma2-plugin-extensions-hetweer ??= "cda2db6db85cea3c1051873536a1bb41c2a8fe27"
SRCREV_pn-enigma2-plugin-extensions-infobarweather ??= "49c4a4963fa5075071b1befbc56bc4076f1210a8"
SRCREV_pn-enigma2-plugin-extensions-magentamusik360 ??= "3ef387ebeff2d4e027fbfcc70f8144901d07b76c"
SRCREV_pn-enigma2-plugin-extensions-meteoviewer ??= "602c8d0a18c640ef1efd589a9c2d731becfa707e"
SRCREV_pn-enigma2-plugin-extensions-newsreader ??= "edc525baef85b85af418cf1b0ee7da5d68780a3b"
SRCREV_pn-enigma2-plugin-extensions-nfsserver ??= "e7880e3fd7d6167bd47a8db759a4c0c8a1f044c1"
SRCREV_pn-enigma2-plugin-extensions-openairplay ??= "1c9d2df4411110dcd7bbc5d61f5a01aefe9725f7"
SRCREV_pn-enigma2-plugin-extensions-openwebif ??= "f65c54a175b702a6010a7e29178b63dea768e5a3"
SRCREV_pn-enigma2-plugin-extensions-oroscopoitalia ??= "42ceffdade8719c30d5f5dc8f64b61eda3762a1f"
SRCREV_pn-enigma2-plugin-extensions-oscamstatus ??= "0004ed50f79a97c51007306550fbe699b53f038d"
SRCREV_pn-enigma2-plugin-extensions-permanentvfdclock ??= "2a07a31b1789fa6bb245e9160700ce42835e725b"
SRCREV_pn-enigma2-plugin-extensions-ppanel ??= "58314dc72c8c59f40be0a0ff878045fb2aab561a"
SRCREV_pn-enigma2-plugin-extensions-remotecontrolchannel ??= "fa7538b0fd1a2e7f6f03541e4c78df501a5665be"
SRCREV_pn-enigma2-plugin-extensions-remotechannelstreamconverter ??= "0c021ed3ab0db855063d36cde8453dc49eec28c5"
SRCREV_pn-enigma2-plugin-extensions-screenposition ??= "0b2e06b2580ce486bc52e99508b8ee045aacc936"
SRCREV_pn-enigma2-plugin-extensions-serienrecorder ??= "ff7f7a8e73041d5ca22b3b7ba17aa334edf9e6ca"
SRCREV_pn-enigma2-plugin-extensions-setpicon ??= "6b777ed10fba7a825ba99ca8a27f6c381dee6d16"
SRCREV_pn-enigma2-plugin-extensions-shootyourscreen ??= "abd5cda28ce51add3d049ae91f2f1fc2247d6bda"
SRCREV_pn-enigma2-plugin-extensions-simpleumount ??= "c8517274748ebe7789b03cfcb4ff142332e7ea02"
SRCREV_pn-enigma2-plugin-extensions-snmpagent ??= "450ed959a78918a08a3df5a58acb99d2bdc90f5b"
SRCREV_pn-enigma2-plugin-extensions-streaminterface ??= "faf0c907fefa67d777f3745c9eab957794b8a727"
SRCREV_pn-enigma2-plugin-extensions-systemtools ??= "88dbcac49202a4d850221841b8f16891f684a375"
SRCREV_pn-enigma2-plugin-extensions-telekomsport ??= "e2f3882418baedb2c02d7265c932a2e9d3e84b1c"
SRCREV_pn-enigma2-plugin-extensions-usbformatwizard ??= "ecc03026bf110acb5a8f5f2f987a389516f23553"
SRCREV_pn-enigma2-plugin-extensions-wakeonlan ??= "e36eb4e0a395c0c721fbcbf45f93b895c2fab430"
SRCREV_pn-enigma2-plugin-extensions-xpower ??= "a61decfcf1b7508ad18bebe4471e4a9e68e81ada"
SRCREV_pn-enigma2-plugin-systemplugins-autobouquetsmaker ??= "55dd4391f08838fec7b8c74f69f4416ca4bac85b"
SRCREV_pn-enigma2-plugin-systemplugins-autoshutdown ??= "1652534fc40ac7423dc87a65c0ed0d7a55de4745"
SRCREV_pn-enigma2-plugin-systemplugins-crossepg ??= "927249e5e9d01141049251df2ea85ad0acd90b59"
SRCREV_pn-enigma2-plugin-systemplugins-misplslcnscan ??= "82f7d412384e19b1ef4d0bf472b4c8aa609f98c6"
SRCREV_pn-enigma2-plugin-systemplugins-terrestrialscan ??= "751301c3b24fec07609bccf5494d8924feac9558"
SRCREV_pn-enigma2-plugin-systemplugins-satscan ??= "97f621806138d80ef46fc31dffb227d21340347b"
SRCREV_pn-enigma2-plugin-systemplugins-servicemp3 ??= "8e111caaf0ae72e2f5c153d8f02c97dfd8b06e48"

# enigma2 and binaries
SRCREV_pn-aio-grab ??= "6540d2d6e327965d06151f29fb60e3444eeadb00"
SRCREV_pn-astra-sm ??= "44bcd2852b7f315233267f639730e0e21b9b6c22"
SRCREV_pn-bitstream ??= "96cdd783c50631f3d17bf5e2c7f3ec5468db3931"
SRCREV_pn-blindscan-s2 ??= "632830aca27f22a412641998dee84319182d44e0"
SRCREV_pn-dcadec ??= "b93deed1a231dd6dd7e39b9fe7d2abe05aa00158"
SRCREV_pn-dvblast ??= "bca0be676f33889e38a9a63a0b7b498663e1bdc0"
SRCREV_pn-dvbsnoop ??= "5b236b178ee1bc6cd6e16ff88ba5748b24237691"
SRCREV_pn-dvdauthor ??= "fe8fe3578f95f34889e7ed17591d02dceb4f42ed"
SRCREV_pn-edid-decode ??= "5332a3b76080e17137db15fd31e2d3949cef5f84"
SRCREV_pn-enigma2 ??= "${AUTOREV}"
SRCREV_pn-exteplayer3 ??= "52666caaf08543122ad735e300acb2c2009c83d5"
SRCREV_pn-fakelocale ??= "586590f28af205ced71f45a0e3f67abec82622fd"
SRCREV_pn-hotplug-e2-helper ??= "68eedb242efc29289c71e0d2694bf47795df3c7f"
SRCREV_pn-minidlna ??= "cfb775682b88f6349cb7fa64f82fe33035436157"
SRCREV_pn-satipclient ??= "1c2ef4c13604e4edeb4d553c67e2d317e2040eab"
SRCREV_pn-shairplay ??= "096b61ad14c90169f438e690d096e3fcf87e504e"
SRCREV_pn-streamproxy ??= "0b4eddcc7f25127e781a8ef79926f3bfc6126a78"
SRCREV_pn-tuxbox-common ??= "${AUTOREV}"
SRCREV_pn-tuxtxt-enigma2 ??= "1402795d660955757d87967b8ff1e3790625f9c1"
SRCREV_pn-udpxy ??= "23b434374d76e5de74138d44cbb8bda1b32dcfe0"
SRCREV_pn-upscaledb ??= "cb124e1f91601872a7b3bd4da10e5fa97a8da86b"
SRCREV_pn-satipclient ??= "1c2ef4c13604e4edeb4d553c67e2d317e2040eab"
SRCREV_pn-satpi ??= "fe180a5269d0c7b66707bc9e4b3b1da291ca40f2"
SRCREV_pn-enigma2-boxlogos ??= "f802a3df45171648ab9f06a5ff03bb5a402bc60a"

# ffmpeg
SRCREV_pn-ffmpeg ??= "b48951bd29fbec166428efb5a0e27f51ff98fd84"

# gstreamer
SRCREV_pn-gstreamer1.0-plugin-dvbmediasink ??= "1d197313832d39fdaf430634f62ad95a33029db0"
SRCREV_pn-gstreamer1.0-plugin-subsink ??= "2c4288bb29e0781f27aecc25c941b6e441630f8d"
SRCREV_pn-gst-ifdsrc ??= "3beb10950bb79977339d9ca6c638bf962392fca4"
SRCREV_pn-gst-plugin-subsink ??= "2c4288bb29e0781f27aecc25c941b6e441630f8d"
SRCREV_pn-gstplayer ??= "a289516735c506c5db3b8ab146d3cd3db2674ddc"

# libs
# no SRCREV available
SRCREV_pn-libaacs ??= "${AUTOREV}"
SRCREV_pn-libbluray ??= "bb5bc108ec695889855f06df338958004ff289ef"
SRCREV_pn-libdca ??= "95c4bd8baee808ec563120f463111e2cd6cd240e"
SRCREV_pn-libdreamdvd ??= "02a0e7cb0c37f98fbbaae087f7f5c010c5c7c9a3"
SRCREV_pn-libdvbsi++ ??= "f3c40ea6daa94a3bfeeee1ef9381c68629a68b81"
SRCREV_pn-libdvdnav ??= "25229a54b2c4be9930d677f6abe3a0025514f3db"
SRCREV_pn-libdvdread ??= "329ec88257ecaf64a3144644a423289bb3da8ef6"
SRCREV_pn-libsquish ??= "52e7d93c5947f72380521116c05d97c528863ba8"
SRCREV_pn-libtuxtxt ??= "1402795d660955757d87967b8ff1e3790625f9c1"
SRCREV_pn-libudfread ??= "b3e6936a23f8af30a0be63d88f4695bdc0ea26e1"
SRCREV_pn-libdvbcsa ??= "f25351d70589ec97ae6fb7590786c9aa38b999d4"

# dima-plugins
SRCREV_pn-enigma2-plugin-extensions-automatic-fullbackup ??= "e4f4086661c8e567b4ee3853ffed70ed4ad0fdc4"
SRCREV_pn-enigma2-plugin-extensions-historyzapselector ??= "0c880416c777203525e69fd5679b34ebab7a1006"
SRCREV_pn-enigma2-plugin-extensions-sundtekcontrolcenter ??= "63b84e1c50666b5fdd65f2b6f6abe45da3340176"
SRCREV_pn-enigma2-plugin-extensions-tmbd ??= "3d1b39cb4886ee765df6136da0c68b6140caa368"
SRCREV_pn-enigma2-plugin-extensions-ts-sateditor ??= "d99a26e3cd3c7bd46b9c7c96e9bf3675d5f1d9a9"
SRCREV_pn-enigma2-plugin-extensions-vcs ??= "ace56dcc2975ab55a72137c7382e2c8c37244691"
SRCREV_pn-enigma2-plugin-extensions-xmodem ??= "0458a1cf91e758c20014c5093d88677d8d8032b2"
SRCREV_pn-enigma2-plugin-systemplugins-devicemanager ??= "54eddd18b93d2b7367355f19d3a2b8c14096d4d5"
SRCREV_pn-enigma2-plugin-systemplugins-extnumberzap ??= "f0374c32bd7ca0b39a079fa0ee92636b45fc2b0c"
SRCREV_pn-enigma2-plugin-systemplugins-extrafancontrol ??= "ed50ac9c63717bd85c1843eb891637e7fa5900ba"
SRCREV_pn-enigma2-plugin-systemplugins-mountmanager ??= "85d27955a3b42dac44b444da1e17ef374894ac2a"
SRCREV_pn-enigma2-plugin-systemplugins-signalfinder ??= "5167e4a1f7a0d0a4eb2a7ff26bb160ad0481276a"
SRCREV_pn-enigma2-plugin-systemplugins-satipserver ??= "146216b8498e60c62eb55c71e1830d3977ce7bcd"

# plugins
SRCREV_pn-enigma2-plugin-extensions-backupsuite ??= "4501eb8131650b2304dfef0d35e4f554100c9a3e"
SRCREV_pn-enigma2-plugin-extensions-blurayplayer ??= "8707ca0fbd6a49cd3d5637b9619a72b10c366da4"
SRCREV_pn-enigma2-plugin-extensions-dlnabrowser ??= "d2a51c715fd98415c7ef76b1b7c8d30854ecff98"
SRCREV_pn-enigma2-plugin-extensions-epgimport ??= "537379700f71e78002cca1ca927fc01a14550775"
SRCREV_pn-enigma2-plugin-extensions-fontinfo ??= "cab3f53f4ba90140e4bda4ac8aa511f4c25d0044"
SRCREV_pn-enigma2-plugin-extensions-freechannels ??= "735d86d35da080fbac54cfcfc50f78f35779f88b"
SRCREV_pn-enigma2-plugin-extensions-fritzcall ??= "e894ae40d94bbb18f008eb5da6b8660284f4c759"
SRCREV_pn-enigma2-plugin-extensions-hdmitest ??= "0da5420409726d7d215458709beb968a0fb04742"
SRCREV_pn-enigma2-plugin-extensions-jediepgxtream ??= "81988420c81e3ec3815a046737064c347b4f0d4a"
SRCREV_pn-enigma2-plugin-extensions-jedimakerxtream ??= "5d2218ae6fe0286d7103a87884f07ea57f92819d"
SRCREV_pn-enigma2-plugin-extensions-bouquetmakerxtream ??= "cfa9342171072c58b70bb96b321cfa5545c1fe27"
SRCREV_pn-enigma2-plugin-extensions-kodi ??= "3d082e9c3d83e4af466d7507a5960c7a9a8813f1"
SRCREV_pn-enigma2-plugin-extensions-managerautofs ??= "39102b04d417e90678536e149f162c287c674e54"
SRCREV_pn-enigma2-plugin-extensions-modifyplifullhd ??= "5de9e609d02bf96357ff28ba9fdcf53f49d9bd71"
SRCREV_pn-enigma2-plugin-extensions-moviemanager ??= "da0bc9e28caeca1e3d8aa12e4294e05ee7ba3ea6"
SRCREV_pn-enigma2-plugin-extensions-qthbbtv ??= "2067e667d7207b610c265c05690f3d13c0fc02f0"
SRCREV_pn-enigma2-plugin-extensions-qtstalker ??= "2067e667d7207b610c265c05690f3d13c0fc02f0"
SRCREV_pn-enigma2-plugin-extensions-refreshbouquet ??= "0d4b9506bfbda44956061fbef97bf5bf1d2c58a3"
SRCREV_pn-enigma2-plugin-extensions-subssupport ??= "7d583fe93736c860ee1d806f64fe5b4524acdef1"
SRCREV_pn-enigma2-plugin-extensions-xstreamity ??= "dd9fc8b4e3ff39551da8787160f2eb84256ada10"
SRCREV_pn-enigma2-plugin-extensions-youtube ??= "22766636e9e1496da1e607b30265e903dfe8c2e7"
SRCREV_pn-enigma2-plugin-extensions-iptv-org-playlists ??= "4d0456a218c14bec4a0118c0d2bfd7fed2a5b4f0"
SRCREV_pn-enigma2-plugin-extensions-openmultiboot ??= "40f921733c07d0b19cf2281b9ba4c690ca09ada3"
SRCREV_pn-enigma2-plugin-systemplugins-hrtunerproxy ??= "30d0f9b66c186278d32a52a01a3cb6d63807042c"
SRCREV_pn-enigma2-plugin-systemplugins-quadpip ??= "a3195e60a48241ceea1dc4e4ead703640f4538ad"
SRCREV_pn-enigma2-plugin-systemplugins-serviceapp ??= "947f62ed5c8bcce76e5353193ae2e04c327e6140"
SRCREV_pn-enigma2-plugin-systemplugins-radiotimesxmltvemulator ??= "1b1d398ccdd82bdfbd92be0e186b14c8a21ae5c0"
SRCREV_pn-enigma2-plugin-systemplugins-terrestrialbouquet ??= "564df07777d64dd420eb1edd44170d29c08977b4"
SRCREV_pn-enigma2-plugin-systemplugins-m3uiptv ??= "0cad3601f661445518edba11cd3bb122e6b77f2e"
SRCREV_pn-enigma2-binary-plugins ??= "3e4dcf349b6e917b35c6613ab5abf790629e8239"
SRCREV_pn-enigma2-plugins ??= "2f5a915cd2733a641562b59f860ec68461c1c22e"

# python
SRCREV_pn-${PYTHON_PN}-sendfile ??= "2ffdd452b03dd4b639cda985bd67b8d4c0c34a5f"
SRCREV_pn-pydpflib ??= "fcd1158129188354986b023fdfb4d107597d7661"
SRCREV_pn-streamlink ??= "2bcdafc67824a60d65bce8bea65d019061c4e360"

# settings
SRCREV_pn-enigma2-plugin-settings-hans-13e-19e-23e-28e ??= "${AUTOREV}"
SRCREV_pn-enigma2-plugin-settings-hans-19e-23e ??= "${AUTOREV}"
SRCREV_pn-enigma2-plugin-settings-hans-19e-23e-28e ??= "${AUTOREV}"
SRCREV_pn-enigma2-plugin-settings-hans-19e-23e-basis ??= "${AUTOREV}"
SRCREV_pn-enigma2-plugin-settings-hans-9e-13e-19e-23e-28e ??= "${AUTOREV}"
SRCREV_pn-enigma2-plugin-settings-hans-9e-13e-19e-23e-28e-rotating ??= "${AUTOREV}"
SRCREV_pn-enigma2-plugin-settings-hans-kabelnl ??= "${AUTOREV}"
SRCREV_pn-enigma2-plugin-settings-morph883-0.8w-13e-19.2e-28.2e ??= "${AUTOREV}"
SRCREV_pn-enigma2-plugin-settings-morph883-0.8w-13e-19.2e ??= "${AUTOREV}"
SRCREV_pn-enigma2-plugin-settings-morph883-0.8w-13e ??= "${AUTOREV}"
SRCREV_pn-enigma2-plugin-settings-morph883-0.8w-4.8e-13e ??= "${AUTOREV}"
SRCREV_pn-enigma2-plugin-settings-morph883-13e-16e-19.2e-23.5e ??= "${AUTOREV}"
SRCREV_pn-enigma2-plugin-settings-morph883-13e-16e-19.2e ??= "${AUTOREV}"
SRCREV_pn-enigma2-plugin-settings-morph883-13e-16e ??= "${AUTOREV}"
SRCREV_pn-enigma2-plugin-settings-morph883-13e-19.2e-23.5e ??= "${AUTOREV}"
SRCREV_pn-enigma2-plugin-settings-morph883-13e-19.2e-23.5e-28.2e ??= "${AUTOREV}"
SRCREV_pn-enigma2-plugin-settings-morph883-13e-19.2e-28.2e ??= "${AUTOREV}"
SRCREV_pn-enigma2-plugin-settings-morph883-13e-19.2e-42e ??= "${AUTOREV}"
SRCREV_pn-enigma2-plugin-settings-morph883-13e-19.2e ??= "${AUTOREV}"
SRCREV_pn-enigma2-plugin-settings-morph883-13e-23.5e ??= "${AUTOREV}"
SRCREV_pn-enigma2-plugin-settings-morph883-13e-28.2e ??= "${AUTOREV}"
SRCREV_pn-enigma2-plugin-settings-morph883-13e-42e ??= "${AUTOREV}"
SRCREV_pn-enigma2-plugin-settings-morph883-13e ??= "${AUTOREV}"
SRCREV_pn-enigma2-plugin-settings-morph883-30w-13e-19.2e ??= "${AUTOREV}"
SRCREV_pn-enigma2-plugin-settings-morph883-30w-13e ??= "${AUTOREV}"
SRCREV_pn-enigma2-plugin-settings-morph883-4.8e-13e-19.2e ??= "${AUTOREV}"
SRCREV_pn-enigma2-plugin-settings-morph883-4.8e-13e ??= "${AUTOREV}"
SRCREV_pn-enigma2-plugin-settings-morph883-9e-13e-19.2e ??= "${AUTOREV}"
SRCREV_pn-enigma2-plugin-settings-morph883-9e-13e ??= "${AUTOREV}"
SRCREV_pn-enigma2-plugin-settings-morph883-motor ??= "${AUTOREV}"
SRCREV_pn-enigma2-plugin-settings-ciefp-e2-1sat-19e ??= "${AUTOREV}"
SRCREV_pn-enigma2-plugin-settings-ciefp-e2-2sata-19e-13e ??= "${AUTOREV}"
SRCREV_pn-enigma2-plugin-settings-ciefp-e2-2satb-19e-16e ??= "${AUTOREV}"
SRCREV_pn-enigma2-plugin-settings-ciefp-e2-3sata-9e-10e-13e ??= "${AUTOREV}"
SRCREV_pn-enigma2-plugin-settings-ciefp-e2-3satb-19e-16e-13e ??= "${AUTOREV}"
SRCREV_pn-enigma2-plugin-settings-ciefp-e2-4sata-28e-19e-13e-30w ??= "${AUTOREV}"
SRCREV_pn-enigma2-plugin-settings-ciefp-e2-4satb-19e-16e-13e-0.8w ??= "${AUTOREV}"
SRCREV_pn-enigma2-plugin-settings-ciefp-e2-5sat-19e-16e-13e-1.9e-0.8w ??= "${AUTOREV}"
SRCREV_pn-enigma2-plugin-settings-ciefp-e2-6sat-23e-19e-16e-13e-1.9e-0.8w ??= "${AUTOREV}"
SRCREV_pn-enigma2-plugin-settings-ciefp-e2-7sat-23e-19e-16e-13e-4.8e-1.9e-0.8w ??= "${AUTOREV}"
SRCREV_pn-enigma2-plugin-settings-ciefp-e2-8sat-28e-23e-19e-16e-13e-4.8e-1.9e-0.8w ??= "${AUTOREV}"
SRCREV_pn-enigma2-plugin-settings-ciefp-e2-9sat-39e-28e-23e-19e-16e-13e-4.8e-1.9e-0.8w ??= "${AUTOREV}"
SRCREV_pn-enigma2-plugin-settings-ciefp-e2-10sat-39e-28e-23e-19e-16e-13e-9e-4.8e-1.9e-0.8w ??= "${AUTOREV}"
SRCREV_pn-enigma2-plugin-settings-ciefp-e2-13sat-42e-39e-28e-23e-19e-16e-13e-9e-7e-4.8e-1.9e-0.8w-5w ??= "${AUTOREV}"
SRCREV_pn-enigma2-plugin-settings-ciefp-e2-16sat-42e-39e-28e-26e-23e-19e-16e-13e-10e-9e-7e-4.8e-1.9e-0.8w-4w-5w ??= "${AUTOREV}"
SRCREV_pn-enigma2-plugin-settings-ciefp-e2-18sat-42e-39e-36e-33e-28e-26e-23e-19e-16e-13e-10e-9e-7e-4.8e-1.9e-0.8w-4w-5w ??= "${AUTOREV}"
SRCREV_pn-enigma2-plugin-settings-ciefp-e2-motor-75e-34w ??= "${AUTOREV}"

# skins
SRCREV_pn-enigma2-plugin-skins-magic ??= "8b5fb84750d8ed34048e6d6fa6e4fee1711de4d3"
SRCREV_pn-enigma2-plugin-skins-glamouraurafhd ??= "580813d47a7cf1f3a129ff6102ec945e59a65c05"
SRCREV_pn-enigma2-plugin-skins-e2darkos ??= "b02e4d0a5a6caf008bc742dc3d06d0eff35c3a92"
SRCREV_pn-enigma2-plugin-skins-pd1loi-hd-night ??= "933b6530ed09c4e8c6779c8a77e900169e6c492f"
SRCREV_pn-enigma2-plugin-skins-pli-hd ??= "ba150c878af2096cc7f1d3600912e9276592815d"
SRCREV_pn-enigma2-plugin-skins-pli-hd-fullnight ??= "99adc658e434d32f30994445e5396e17e154aa28"
SRCREV_pn-enigma2-plugin-skins-simple-gray ??= "da580e1ba4b3d2a8cfd6ccfd6434e5a98f5b8eba"
SRCREV_pn-enigma2-skins ??= "472e9d9257dbef16205b00b3dc748eeddc10e3aa"

# softcams
SRCREV_pn-enigma2-plugin-softcams-oscam ??= "58c12d43744915c27f44fe911e55064aec8ea161"
SRCREV_pn-enigma2-plugin-softcams-oscam-emu ??= "83643e17a3d5a0810a9f7e3e572b1b5a6681f473"
SRCREV_pn-enigma2-plugin-softcams-oscam-whitelist ??= "${AUTOREV}"

# wlan kernel modules
SRCREV_pn-kernel-module-88xxau ??= "307d694076b056588c652c2bdaa543a89eb255d9"
SRCREV_pn-kernel-module-rt8188eu ??= "5fbebcb35b88c7eeaada387350d4aac19d98b461"
SRCREV_pn-kernel-module-8192eu ??= "ab35c7e9672f37d75b7559758c99f6d027607687"
SRCREV_pn-kernel-module-8723bu ??= "c849078a5209767d19321b7dded6a21d71619b2c"
SRCREV_pn-kernel-module-88x2bu ??= "342c46353b523dee8c61282eb1cab5788c7d3386"
SRCREV_pn-kernel-module-8821cu ??= "7fd04a699ef0632c890d98b755ecf09e2c2b9c39"
SRCREV_pn-kernel-module-r8723bs ??= "7708383b086b31703d5b50b8ffa45991531cbe1c"
SRCREV_pn-kernel-module-8188fu ??= "d488596918d4e339bc9b5dd3bbeabea1751b97e5"
SRCREV_pn-kernel-module-8852cu ??= "a246437004417a999aa07be85a9674f3b0bbf4bd"

#others
SRCREV_pn-yafc ??= "98afe0ccafe3739148609a1572db6e380f3ea5b2"
SRCREV_pn-rtmpdump ??= "3a69b314a5763c370406149dc1be456db294065a"
SRCREV_pn-iptvsubparser ??= "e00b59f17663b32f35395c83eb7fec644e138ece"
SRCREV_pn-f4mdump ??= "7cf456b3d47e2187f8f559f43a18cd05a31c8780"
SRCREV_pn-hlsdl ??= "42dcfa401deedbdc1af22ae9e5a8965563a6583b"
SRCREV_pn-rclone ??= "c2635e39cc462210500bbcbab43147096c8cdd35"
SRCREV_pn-djmount ??= "372370c667dbeea557c4c7ea47a8a3da3a594729"
SRCREV_pn-pyload ??= "d64551b14adc29803274e358b7f2b447df765395"
SRCREV_pn-openresolv ??= "1afa8e2c1c7bdd5362afb2cc482e85fb01cf5f6d"
SRCREV_pn-ofgwrite ??= "6237842be52c288f4c9bf96cd696b74b7a06a1a9" 
SRCREV_pn-openmultiboot ??= "fd923638856fb50da631ef16ca1e7ffb6b807261"
SRCREV_pn-minisatip ??= "69d85b8c41f26765b87be2eec4a381634df0a9d9"

# sdgradio
SRCREV_pn-dab-cmdline-sdgradio ??= "22152fa509f52dfa2a8e6f6cfb97d2ebc444353f"
SRCREV_pn-dab-cmdline-sdgradio-pcm ??= "22152fa509f52dfa2a8e6f6cfb97d2ebc444353f"
SRCREV_pn-dab-cmdline-sdgradio-wav ??= "22152fa509f52dfa2a8e6f6cfb97d2ebc444353f"
SRCREV_pn-enigma2-plugin-extensions-sdgradio ??= "3577df700dd03ba0ac66c2766180c3863ceecab7"
SRCREV_pn-liquid-dsp ??= "4892ebbc04ef57dd6f603d3f4ece253d8c2bd571"
SRCREV_pn-redsea ??= "fcc6e1ddc787f9dba7500983a840ad21a39490c1"
SRCREV_pn-rtl-sdr ??= "619ac3186ea0ffc092615e1f59f7397e5e6f668c"
```
